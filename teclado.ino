// Números
//char t0 = ''; 
bool asterisco = false;
int t1 = -1;
// Filas
int f0 = 42;
int f1 = 43;
int f2 = 44;
int f3 = 45;
// Columnas
int c0 = 49;
int c1 = 48;
int c3 = 47;

void setup() {
  DDRL = B11110000; // Definimos el PORTL 
  PORTC= B11110000; // activamos el pull-up interno de las líneas entrada PL7-PL4
}

void loop() {
  val = PINL; 
  switch(val){
    // Primera colunma
    case 0xEE:
      if(asterisco)t1 = 3;
      break;
    case 0xDE:
      if(asterisco)t1 = 6;
      break;
    case 0xBE:
      if(asterisco)t1 = 9;
      break;
    // Segunda colunma
    case 0xED:
      if(asterisco)t1 = 2;
      break;
    case 0xDD:
      if(asterisco)t1 = 5;
      break;
    case 0xBD:
      if(asterisco)t1 = 8;
      break;
    case 0x7D:
      if(asterisco)t1 = 0;
      break;
    // Tercera colunma
    case 0xEB:
      if(asterisco)t1 = 1;
      break;
    case 0xDB:
      if(asterisco)t1 = 4;
      break;
    case 0xBB:
      if(asterisco)t1 = 7;
      break;
    case 0x7B:
      asterisco = true;
      break;
    default: 
      break;
  }
  if(t1 != -1){
    Serial.println(t1); 
    asterisco = false;
  }
}
